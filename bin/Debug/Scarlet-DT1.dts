/dts-v1/;
/plugin/;

/ {
    /* Generated by Scarlet. */
    compatible = "ti,beaglebone", "ti,beaglebone-black";
    part-number = "scarlet-pins";
    version = "00A0";
    
    exclusive-use =
        "i2c2",
        "P9.19",
        "P9.20";
    
    fragment@3 {
        target = <&am33xx_pinmux>;
        __overlay__ {
            bbb_i2c2_pins: pinmux_bbb_i2c2_pins {
                pinctrl-single,pins = <
                    0x17C 0x73
                    0x178 0x73
                >;
            };
        };
    };
    
    fragment@21 {
        target = <&i2c2>;
        __overlay__ {
            status = "okay";
            pinctrl-names = "default";
            pinctrl-0 = <&bbb_i2c2_pins>;
            clock-frequency = <100000>;
            #address-cells = <1>;
            #size-cells = <0>;
        };
    };
    
};
